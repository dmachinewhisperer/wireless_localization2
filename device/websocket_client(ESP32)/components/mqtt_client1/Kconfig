## device/websocket_client(ESP32)/components/mqtt_client1/Kconfig
```kconfig
menu "MQTT Client Config"
    choice BROKER_URI_SOURCE
        prompt "Broker endpoint"
        default BROKER_URL_FROM_STDIN
        help
            Selects the source of Broker server endpoint.

        config BROKER_URL_FROM_STRING
            bool "From string"

        config BROKER_URL_FROM_STDIN
            bool "From stdin"
    endchoice

    config BROKER_URL
        string "Broker endpoint"
        depends on BROKER_URL_FROM_STRING
        default "mqtt://echo.mqtts.events"
        help
            URL of Broker endpoint

endmenu
```

## device/websocket_client(ESP32)/components/ws_client/Kconfig
```kconfig
menu "Websocket Client Config"

    choice WEBSOCKET_URI_SOURCE
        prompt "Websocket URI source"
        default WEBSOCKET_URI_FROM_STDIN
        help
            Selects the source of websocket server URI.

        config WEBSOCKET_URI_FROM_STRING
            bool "From string"

        config WEBSOCKET_URI_FROM_STDIN
            bool "From stdin"
    endchoice

    config WEBSOCKET_URI
        string "Websocket endpoint URI"
        depends on WEBSOCKET_URI_FROM_STRING
        default "ws://echo.websocket.events"
        help
            URL of websocket endpoint of server

    if CONFIG_IDF_TARGET = "linux"
      config GCOV_ENABLED
          bool "Coverage analyzer"
          default n
          help
              Enables coverage analyzing for host tests.
      endif

    config ESP_WS_CLIENT_ENABLE_DYNAMIC_BUFFER
        bool "Enable websocket client dynamic buffer for send and receive data"
        default n
        help
            Enable this option will reallocated buffer when send or receive data and free them when end of use.
            This can save about 2 KB memory when no websocket data send and receive.
endmenu
```
